## drivers/urbetter/Kconfig
```kconfig
menu "urbetter customized drivers"

config BT_RDA_587X_MODULE_SUPPORT	
    bool "RDA Module 587X Support"
    depends on BT_HCIUART
    default n	
    ---help---	  
      If you say Y here, you can use RDA Module 587X  
config URBETTER_GSENEOR_MMA7660
	tristate "Urbetter 3-Axis G sensor"
	default n
	---help---
	  Say Y here if you want to support Urbetter 3-Axis G sensor.

choice
depends on URBETTER_GSENEOR_MMA7660
prompt "Select direction(board)"
default MMA7660_UT7GM

config MMA7660_UT7GM
	bool "UT7GM direction"
	---help---
	  select the sensor direction for UT7GM

config MMA7660_UT10GM
	bool "UT10GM direction"
	---help---
	  select the sensor direction for UT10GM

config MMA7660_DEFAULT
	bool "default direction"
	---help---
	  select the sensor direction for default

endchoice	

	  
config URBETTER_REGWATCH
	tristate "Urbetter register watcher(read/write physical register for debug)"
	default y
	---help---
	  Say Y here if you want to support Urbetter register watcher(read/write physical register for debug).

config URBETTER_TOUCHSCREEN_FT5X0X
	tristate "touchscreen driver ft5x0x"
	default y
	---help---
	  Say Y here to enable the driver for the touchscreen on the S3C SMDK board.

endmenu
```
